/*----------------------------------------------------------------------------
 *      
 *----------------------------------------------------------------------------
 *      Name:    BUTTONS.H
 *      Purpose: Microprocessors Laboratory
 *----------------------------------------------------------------------------
 *      
 *      Author: Pawel Russek AGH University of Science and Technology
 *---------------------------------------------------------------------------*/

#include "MKL46Z4.h"                    /* Device header */
#include "buttons.h"
#include "pit.h"

#define SW1_PIN 3												/* SW1 switch is on port C - pin 3 */
#define SW3_PIN 12											/* SW3 switch is on port C - pin 12 */

/*Number of IRQ generated by PORTC_PORTD interrupt*/
#define PORTC_D_IRQ_NBR PORTC_PORTD_IRQn		/* ToDo 5.1: Define interrupt (IRQ) number for PORTC_PORTD. See interrupt vector assignments in NVIC section of KL46 Sub-Family Reference Manual - NVIC section*/ 


/*----------------------------------------------------------------------------
	Interrupt service routine
	Button will cause PORTC_PORTD interrupt 
 *----------------------------------------------------------------------------*/
void PORTC_PORTD_IRQHandler(void){	// ????	/* ToDo 5.2: Put a proper name of PORTC_PORTD Interrupt service routine ISR. See system_MKL46Z4.s file for function name */ 
	if((PORTC->PCR[SW1_PIN]&PORT_PCR_ISF_MASK) != 0) { faster(); pit_change();}  // sprawdza na ktorym bicie wystapilo przerwanie
	if((PORTC->PCR[SW3_PIN]&PORT_PCR_ISF_MASK) != 0) { slower(); pit_change();}
	
	while((FPTC->PDIR&(1<<SW1_PIN))==0);//!!!!!!!!!!!!!!!!1				/* ToDo 7.1: Enable wait in the interrupt for SW1 button release */
	
	PORTC->PCR[SW1_PIN] |= PORT_PCR_ISF_MASK; 		/* ToDo 5.3: Clear interrupt service flag in port control register otherwise int. remains active */
	PORTC->PCR[SW3_PIN] |= PORT_PCR_ISF_MASK; // zerujemy flage obecnosci przerwania wpisujac logiczne 1
}

/*----------------------------------------------------------------------------
	Function initializes port C pin for switch 1 (SW1) handling
	and enables PORT_C_D interrupts
 *----------------------------------------------------------------------------*/
void buttonsInitialize(void){
	
	SIM->SCGC5 |=  SIM_SCGC5_PORTC_MASK; 					/* Enable clock for port C */
	PORTC->PCR[SW1_PIN] |= PORT_PCR_MUX(1);      	/* Pin PTC3 is GPIO */
	PORTC->PCR[SW3_PIN] |= PORT_PCR_MUX(1);
	
	/* Port control register for bit 3 of port C configuration. Activate pull up and interrupt */
	PORTC->PCR[SW1_PIN] |=  PORT_PCR_PE_MASK |		/* ToDo 5.4: Set bit in PCR register to enable pull resistor. See KL46 Sub-Family Reference Manual */
													PORT_PCR_PS_MASK;		/* ToDo 5.5: Set bit in PCR register to select pull up. See KL46 Sub-Family Reference Manual */
	PORTC->PCR[SW1_PIN] |= 	PORT_PCR_IRQC(0x09);		/* ToDo 5.6: Set value for IRQC bit field in PCR register to select rising edge interrupts for PORTC[3]. See KL46 Sub-Family Reference Manual */
		
	
	/* Wlaczam mozliwosc przerwania dla SW3 */
	PORTC->PCR[SW3_PIN] |=	PORT_PCR_PE_MASK | PORT_PCR_PS_MASK;
	PORTC->PCR[SW3_PIN] |=	PORT_PCR_IRQC(0x09);
	
	/*ARM's Nested Vector Interrupt Controller configuration*/
	NVIC_ClearPendingIRQ(PORTC_D_IRQ_NBR);				/* Clear NVIC any pending interrupts on PORTC_D */
	NVIC_EnableIRQ(PORTC_D_IRQ_NBR);							/* Enable NVIC interrupts source for PORTC_D module */
	NVIC_SetPriority (PORTC_D_IRQ_NBR, 3);			/* ToDo 7.2a: Set PORTC_D interrupt priority level  */ 

}

